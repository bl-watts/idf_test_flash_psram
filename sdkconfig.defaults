## sdkconfig.defaults
```kconfig
CONFIG_ESPTOOLPY_FLASHSIZE_8MB=y
CONFIG_PARTITION_TABLE_CUSTOM=y
CONFIG_PARTITION_TABLE_CUSTOM_FILENAME="partition-table.csv"
CONFIG_ESP_MAIN_TASK_STACK_SIZE=8192

CONFIG_SPIRAM=y
# devc board uses oct spi, D0 charger does not
CONFIG_SPIRAM_MODE_OCT=y 
CONFIG_SPIRAM_ALLOW_NOINIT_SEG_EXTERNAL_MEMORY=y

CONFIG_LITTLEFS_MAX_PARTITIONS=1
CONFIG_LITTLEFS_HUMAN_READABLE=y
#CONFIG_LITTLEFS_FLUSH_FILE_EVERY_WRITE=y
```
